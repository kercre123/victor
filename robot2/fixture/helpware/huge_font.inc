#define HUGE_FONT_WIDTH 24
#define HUGE_FONT_HEIGHT 32
#define HUGE_FONT_SPAN 24

#define HUGE_FONT_LINE_COUNT     (DISPLAY_SCREEN_HEIGHT/HUGE_FONT_HEIGHT)
#define HUGE_FONT_CHARS_PER_LINE (DISPLAY_SCREEN_WIDTH/HUGE_FONT_SPAN)

#define HUGE_FONT_CHAR_START 32
#define HUGE_FONT_CHAR_END 126
#define HUGE_FONT_UNPRINTABLE 95


static const uint32_t gHugeFontGlyphs[] = {
	0x00000000,0x00000000,0x00000000,0x00000000,0x00000000,0x00000000,0x00000000,0x00000000,0x00000000,0x00000000,
	0x00000000,0x00000000,0x00000000,0x00000000,0x00000000,0x00000000,0x00000000,0x00000000,0x00000000,0x00000000,0x00000000,0x00000000,0x00000000,0x00000000, /*   */
	0x00000000,0x00000000,0x00000000,0x00000000,0x00000000,0x00000000,0x00000000,0x00000000,0x00000000,0x0f81ffff,
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	0x0c1e0ffe,0x0fde0ffe,0x0ffe0f0e,0x0fffcf00,0x07ffff00,0x007fffc0,0x001ffffc,0x001e7ffe,0x001e0ffe,0x001e0f7e,0x001e0f06,0x00000f00,0x00000f00,0x00000000, /* # */
/*Font too tall*/
	0x00000000,0x00000000,0x00000000,0x03e01f00,0x07c07fc0,0x0780ffe0,0x0780ffe0,0x0f01fff0,0x0f01f1f0,0x0f01e0f0,
	0x7fffffff,0x7fffffff,0x7fffffff,0x0f03c0f0,0x0f87c0f0,0x0fffc1f0,0x07ff81e0,0x03ff83e0,0x03ff0000,0x00fc0000,0x00000000,0x00000000,0x00000000,0x00000000, /* $ */
	0x00000000,0x000003e0,0x000607f8,0x00020ffc,0x00031e1c,0x00031c0e,0x00011c0e,0x00019c0e,0x00019c0e,0x0000ce1c,
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	0x000003ff,0x000003ff,0x000003ff,0x000003ff,0x00000000,0x00000000,0x00000000,0x00000000,0x00000000,0x00000000,0x00000000,0x00000000,0x00000000,0x00000000, /* ' */
/*Font too tall*/
	0x00000000,0x00000000,0x00000000,0x00000000,0x00000000,0x00000000,0x00000000,0x001ff800,0x01ffff80,0x07ffffe0,
	0x3ffffffc,0x7ffffffe,0x7fe007ff,0x7e00007f,0x7000000f,0x40000003,0x00000000,0x00000000,0x00000000,0x00000000,0x00000000,0x00000000,0x00000000,0x00000000, /* ( */
/*Font too tall*/
	0x00000000,0x00000000,0x00000000,0x00000000,0x00000000,0x00000000,0x00000000,0x40000003,0x7000000f,0x7e00007f,
	0x7fe007ff,0x7ffffffe,0x1ffffff8,0x07ffffe0,0x01ffff80,0x001ff800,0x00000000,0x00000000,0x00000000,0x00000000,0x00000000,0x00000000,0x00000000,0x00000000, /* ) */
	0x00000000,0x00101000,0x00701c00,0x00783c00,0x00383800,0x003c7800,0x001c7000,0x001ef000,0x000ee000,0x0007c000,
	0x07ffffc0,0x07ffffc0,0x07ffffc0,0x0007c000,0x000ee000,0x001ef000,0x001c7000,0x003c7800,0x00383800,0x00783c00,0x00701c00,0x00101000,0x00000000,0x00000000, /* * */
	0x00000000,0x0003c000,0x0003c000,0x0003c000,0x0003c000,0x0003c000,0x0003c000,0x0003c000,0x0003c000,0x03ffffc0,
	0x03ffffc0,0x03ffffc0,0x03ffffc0,0x0003c000,0x0003c000,0x0003c000,0x0003c000,0x0003c000,0x0003c000,0x0003c000,0x0003c000,0x00000000,0x00000000,0x00000000, /* + */
/*Font too tall*/
	0x00000000,0x00000000,0x00000000,0x00000000,0x00000000,0x00000000,0x00000000,0x00000000,0x70000000,0x7fe00000,
	0x7fe00000,0x7fe00000,0x3fe00000,0x1fe00000,0x07e00000,0x00000000,0x00000000,0x00000000,0x00000000,0x00000000,0x00000000,0x00000000,0x00000000,0x00000000, /* , */
	0x00000000,0x00000000,0x000f8000,0x000f8000,0x000f8000,0x000f8000,0x000f8000,0x000f8000,0x000f8000,0x000f8000,
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	0x0fe07f00,0x0fe07f00,0x0fe07f00,0x0fe07f00,0x00000000,0x00000000,0x00000000,0x00000000,0x00000000,0x00000000,0x00000000,0x00000000,0x00000000,0x00000000, /* : */
/*Font too tall*/
	0x00000000,0x00000000,0x00000000,0x00000000,0x00000000,0x00000000,0x00000000,0x60000000,0x7fe07f00,0x7fe07f00,
	0x7fe07f00,0x7fe07f00,0x3fe07f00,0x07e07f00,0x00000000,0x00000000,0x00000000,0x00000000,0x00000000,0x00000000,0x00000000,0x00000000,0x00000000,0x00000000, /* ; */
	0x00000000,0x00000000,0x0003c000,0x0007e000,0x0007e000,0x000ff000,0x000ff000,0x000ff000,0x001e7800,0x001e7800,
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	0x0f9ff007,0x0f9ff807,0x0f9ffe07,0x00007f0f,0x00001fff,0x00000fff,0x000007ff,0x000003fe,0x000000f8,0x00000000,0x00000000,0x00000000,0x00000000,0x00000000, /* ? */
/*Font too tall*/
	0x007fe000,0x03fffc00,0x0fffff00,0x1fffffc0,0x3fc01fe0,0x7e0007f0,0x780001f0,0x703fc0f8,0x60fff078,0x61fff87c,
	0x41fff83c,0x43f0fc3c,0x43c03c3c,0x43c03c3c,0x43c03c7c,0x43c03878,0x61f0f9f8,0x63fffff0,0x73fffff0,0x63ffffc0,0x03ffff00,0x00000000,0x00000000,0x00000000, /* @ */
	0x00000000,0x0c000000,0x0fc00000,0x0ff80000,0x0fff8000,0x0ffff800,0x0fffff00,0x00fffff0,0x001fffff,0x001fffff,
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	0x0001f01f,0x0001f01f,0x0001f01f,0x0001f01f,0x0001f83f,0x0000fc7e,0x0000fffe,0x0000fffe,0x00007ffc,0x00003ff8,0x00000fe0,0x00000000,0x00000000,0x00000000, /* P */
/*Font too tall*/
	0x00000000,0x00000000,0x000fff00,0x007ffff0,0x01fffff8,0x07fffffe,0x07ffffff,0x0ff000ff,0x1fc0003f,0x1f80001f,
	0x1f00000f,0x1f00000f,0x1f00000f,0x3f80001f,0x7fc0003f,0x7ff000ff,0x7ffffffe,0x77fffffe,0x63fffff8,0x40ffffe0,0x000fff00,0x00000000,0x00000000,0x00000000, /* Q */
/*Image must be wider than 24*/
	0x00000000,0x00000000,0x00000000,0x0fffffff,0x0fffffff,0x0fffffff,0x0fffffff,0x0fffffff,0x0001f01f,0x0001f01f,
	0x0001f01f,0x0001f01f,0x0003f01f,0x0007f01f,0x001ff83f,0x007ffc7f,0x01fffffe,0x07ff3ffe,0x0ffe3ffc,0x0ff81ff8,0x0fe007e0,0x0f800000,0x0e000000,0x08000000, /* R */
	0x00000000,0x00000000,0x00000000,0x03f003f0,0x07e00ffc,0x07e01ffe,0x07c03fff,0x0fc03fff,0x0f807e1f,0x0f807c1f,
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	0x0f87f81f,0x0f83fe1f,0x0f81ff1f,0x0f807fdf,0x0f803fff,0x0f800fff,0x0f8007ff,0x0f8003ff,0x0f8000ff,0x0f80007f,0x0f80001f,0x00000000,0x00000000,0x00000000, /* Z */
/*Font too tall*/
	0x00000000,0x00000000,0x00000000,0x00000000,0x00000000,0x00000000,0x00000000,0x00000000,0x7fffffff,0x7fffffff,
	0x7fffffff,0x7fffffff,0x7fffffff,0x60000007,0x60000007,0x60000007,0x60000007,0x00000000,0x00000000,0x00000000,0x00000000,0x00000000,0x00000000,0x00000000, /* [ */
	0x00000000,0x00000000,0x00000001,0x00000007,0x0000001f,0x0000007f,0x000001fe,0x00000ff8,0x00003fe0,0x0000ff80,
	0x0003fe00,0x000ff800,0x003fe000,0x00ff8000,0x03fe0000,0x0ff80000,0x3fc00000,0x7f000000,0x7c000000,0x70000000,0x40000000,0x00000000,0x00000000,0x00000000, /* \ */
/*Font too tall*/
	0x00000000,0x00000000,0x00000000,0x00000000,0x00000000,0x00000000,0x60000007,0x60000007,0x60000007,0x60000007,
	0x7fffffff,0x7fffffff,0x7fffffff,0x7fffffff,0x7fffffff,0x00000000,0x00000000,0x00000000,0x00000000,0x00000000,0x00000000,0x00000000,0x00000000,0x00000000, /* ] */
	0x00000000,0x00000200,0x00000300,0x00000380,0x000003c0,0x000003f0,0x000001f8,0x000000fc,0x0000007e,0x0000003f,
	0x0000001f,0x0000001f,0x0000003f,0x0000003f,0x0000007e,0x000000fc,0x000001f8,0x000003e0,0x000003c0,0x00000380,0x00000300,0x00000200,0x00000000,0x00000000, /* ^ */
/*Font too tall*/
	0x00000000,0x00000000,0x00000000,0x00000000,0x00000000,0x00000000,0x00000000,0x00000000,0x00000000,0x00000000,
	0x00000000,0x00000000,0x00000000,0x00000000,0x00000000,0x00000000,0x00000000,0x00000000,0x00000000,0x00000000,0x00000000,0x00000000,0x00000000,0x00000000, /* _ */
	0x00000000,0x00000000,0x00000000,0x00000000,0x00000000,0x00000000,0x00000001,0x00000003,0x00000007,0x0000000f,
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	0x0fffffff,0x0fffffff,0x0fffffff,0x00000787,0x00000787,0x00000787,0x00000787,0x00000787,0x00000787,0x00000000,0x00000000,0x00000000,0x00000000,0x00000000, /* f */
/*Font too tall*/
	0x00000000,0x00000000,0x003fe000,0x00fffc00,0x03ffff00,0x07ffff80,0x07ffff80,0x0fe01fc0,0x0f8007c0,0x0f0003c0,
	0x0f0003c0,0x0f0003c0,0x0f000380,0x07800780,0x43e01f00,0x7fffff80,0x7fffff80,0x7fffff80,0x7fffff80,0x7fffff80,0x00000000,0x00000000,0x00000000,0x00000000, /* g */
	0x00000000,0x00000000,0x00000000,0x0fffffff,0x0fffffff,0x0fffffff,0x0fffffff,0x0fffffff,0x00000f00,0x00000780,
	0x00000380,0x000003c0,0x000003c0,0x000003c0,0x00000fc0,0x0fffffc0,0x0fffff80,0x0fffff80,0x0fffff00,0x0ffffc00,0x00000000,0x00000000,0x00000000,0x00000000, /* h */
	0x00000000,0x00000000,0x0f000000,0x0f000000,0x0f000780,0x0f000780,0x0f000780,0x0f000780,0x0f000780,0x0fffff87,
	0x0fffff87,0x0fffff87,0x0fffff87,0x0fffff87,0x0f000000,0x0f000000,0x0f000000,0x0f000000,0x0f000000,0x0f000000,0x0f000000,0x00000000,0x00000000,0x00000000, /* i */
/*Font too tall*/
	0x00000000,0x00000000,0x00000000,0x00000000,0x00000780,0x00000780,0x00000780,0x00000780,0x00000780,0x40000780,
	0x7fffff87,0x7fffff87,0x7fffff87,0x7fffff87,0x7fffff87,0x00000000,0x00000000,0x00000000,0x00000000,0x00000000,0x00000000,0x00000000,0x00000000,0x00000000, /* j */
	0x00000000,0x00000000,0x00000000,0x0fffffff,0x0fffffff,0x0fffffff,0x0fffffff,0x0fffffff,0x000fc000,0x0007e000,
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	0x0f0003c0,0x0f0003c0,0x0f0003c0,0x0f8007c0,0x0f8007c0,0x07e01f80,0x07ffff80,0x03ffff00,0x01fffe00,0x00fff800,0x001fe000,0x00000000,0x00000000,0x00000000, /* o */
/*Font too tall*/
	0x00000000,0x00000000,0x00000000,0x7fffff80,0x7fffff80,0x7fffff80,0x7fffff80,0x7fffff80,0x03e01e00,0x07800780,
	0x07000380,0x0f0003c0,0x0f0003c0,0x0f0003c0,0x0f8007c0,0x0fe01fc0,0x07ffff80,0x07ffff80,0x03ffff00,0x00fffc00,0x003ff000,0x00000000,0x00000000,0x00000000, /* p */
/*Font too tall*/
	0x00000000,0x00000000,0x003ff000,0x00fffc00,0x03ffff00,0x07ffff80,0x07ffff80,0x0fe01fc0,0x0f8007c0,0x0f0003c0,
	0x0f0003c0,0x0f0003c0,0x07000380,0x07800780,0x03e01e00,0x7fffff80,0x7fffff80,0x7fffff80,0x7fffff80,0x7fffff80,0x00000000,0x00000000,0x00000000,0x00000000, /* q */
	0x00000000,0x00000000,0x00000000,0x00000000,0x00000000,0x0fffff80,0x0fffff80,0x0fffff80,0x0fffff80,0x0fffff80,
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	0x007ff800,0x001fe000,0x007ff800,0x00fffe00,0x03ffff00,0x0ff87f80,0x0ff03f80,0x0fc00f80,0x0f800780,0x0f000180,0x0c000080,0x08000000,0x00000000,0x00000000, /* x */
/*Font too tall*/
	0x00000000,0x00000080,0x00000780,0x00003f80,0x0000ff80,0x0007ff80,0x001fff80,0x40fffc00,0x77fff000,0x7fff8000,
	0x7ffc0000,0x7ff00000,0x7ffc0000,0x3fff8000,0x07fff000,0x00fffe00,0x003fff80,0x0007ff80,0x0000ff80,0x00003f80,0x00000780,0x00000080,0x00000000,0x00000000, /* y */
	0x00000000,0x00000000,0x00000000,0x0f800780,0x0fc00780,0x0fe00780,0x0ff00780,0x0ffc0780,0x0ffe0780,0x0f7f0780,
	0x0f3f8780,0x0f1fc780,0x0f0ff780,0x0f07ff80,0x0f03ff80,0x0f00ff80,0x0f007f80,0x0f003f80,0x0f001f80,0x0f000f80,0x00000000,0x00000000,0x00000000,0x00000000, /* z */
/*Font too tall*/
	0x00000000,0x00000000,0x00000000,0x0003c000,0x0003c000,0x0003c000,0x0003c000,0x0007e000,0x000ff000,0x7ffffffc,
	0x7fffffff,0x7fffffff,0x7ffe7fff,0x7ff83fff,0x6000000f,0x40000007,0x40000007,0x40000007,0x40000007,0x40000007,0x00000000,0x00000000,0x00000000,0x00000000, /* { */
/*Font too tall*/
	0x00000000,0x00000000,0x00000000,0x00000000,0x00000000,0x00000000,0x00000000,0x00000000,0x00000000,0x7fffffff,
	0x7fffffff,0x7fffffff,0x7fffffff,0x00000000,0x00000000,0x00000000,0x00000000,0x00000000,0x00000000,0x00000000,0x00000000,0x00000000,0x00000000,0x00000000, /* | */
/*Font too tall*/
	0x00000000,0x00000000,0x00000000,0x40000007,0x40000007,0x40000007,0x40000007,0x40000007,0x6000000f,0x7ffc3fff,
	0x7ffe7fff,0x7fffffff,0x7ffffffe,0x7ffffffc,0x000ff000,0x0007e000,0x0003c000,0x0003c000,0x0003c000,0x0003c000,0x00000000,0x00000000,0x00000000,0x00000000, /* } */
	0x00020000,0x0007c000,0x0007e000,0x0003f000,0x0000f800,0x00007800,0x00007800,0x00007800,0x0000f800,0x0001f000,
	0x0007e000,0x000fc000,0x001f8000,0x001f0000,0x003e0000,0x003c0000,0x003c0000,0x003e0000,0x001f8000,0x000fe000,0x0007c000,0x00018000,0x00000000,0x00000000, /* ~ */
	0x00000000,0x00000000,0x00000000,0x00000000,0x00000000,0x00000000,0x00000000,0x00000000,0x00000000,0x00000000,
	0x00000000,0x00000000,0x00000000,0x00000000,0x00000000,0x00000000,0x00000000,0x00000000,0x00000000,0x00000000,0x00000000,0x00000000,0x00000000,0x00000000, /*   */
};

static const Font gHugeFont = {
       HUGE_FONT_LINE_COUNT,
       HUGE_FONT_CHARS_PER_LINE,
       HUGE_FONT_HEIGHT,
       HUGE_FONT_WIDTH,
       HUGE_FONT_CHAR_START,
       HUGE_FONT_CHAR_END,
       1, /* CenteredByDefault */
       HUGE_FONT_SPAN==HUGE_FONT_WIDTH,
       gHugeFontGlyphs
};
