#define BIG_FONT_WIDTH 12
#define BIG_FONT_HEIGHT 16

#define BIG_FONT_LINE_COUNT     (DISPLAY_SCREEN_HEIGHT/BIG_FONT_HEIGHT)
#define BIG_FONT_CHARS_PER_LINE (DISPLAY_SCREEN_WIDTH/BIG_FONT_WIDTH)

#define BIG_FONT_CHAR_START 32
#define BIG_FONT_CHAR_END 126


static const uint16_t gBigFontGlyphs[] = {
	0x0000,0x0000,0x0000,0x0000,0x0000,0x0000,0x0000,0x0000,0x0000,0x0000,
	0x0000,0x0000, /*   */
	0x0000,0x0000,0x0000,0x0000,0x39ff,0x39ff,0x383f,0x0000,0x0000,0x0000,
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	0x0000,0x0000, /* ' */
/*Font too tall*/
	0x0000,0x0000,0x01e0,0x0ffc,0x3ffe,0x7807,0x6003,0x4001,0x0000,0x0000,
	0x0000,0x0000, /* ( */
/*Font too tall*/
	0x0000,0x0000,0x0000,0x0000,0x4001,0x7003,0x7c0f,0x1ffe,0x07f8,0x0000,
	0x0000,0x0000, /* ) */
	0x0000,0x0030,0x0660,0x0f60,0x03ec,0x00fc,0x03dc,0x0f60,0x0660,0x0030,
	0x0000,0x0000, /* * */
	0x0000,0x00c0,0x00c0,0x00c0,0x00c0,0x0ffc,0x0ffc,0x00c0,0x00c0,0x00c0,
	0x0000,0x0000, /* + */
/*Font too tall*/
	0x0000,0x0000,0x0000,0x0000,0x3800,0x7800,0x7000,0x0000,0x0000,0x0000,
	0x0000,0x0000, /* , */
	0x0000,0x0060,0x0060,0x0060,0x0060,0x0060,0x0060,0x0060,0x0060,0x0060,
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	0x0000,0x0000, /* : */
/*Font too tall*/
	0x0000,0x0000,0x0000,0x1020,0x3870,0x7870,0x7020,0x0000,0x0000,0x0000,
	0x0000,0x0000, /* ; */
	0x0000,0x0070,0x0070,0x00d8,0x01d8,0x018c,0x038c,0x0306,0x0606,0x0e03,
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	0x0000,0x0000, /* P */
/*Font too tall*/
	0x01c0,0x1ff8,0x3ffe,0x780f,0x7003,0x6003,0x7003,0x780f,0x3ffe,0x1ffc,
	0x03c0,0x0000, /* Q */
	0x0000,0x3fff,0x3fff,0x3fff,0x00c3,0x01c3,0x07c3,0x1fe7,0x3c7e,0x303c,
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	0x0000,0x0000, /* f */
/*Font too tall*/
	0x0000,0x48c0,0x7ff0,0x3ff8,0x3618,0x3618,0x3738,0x33f0,0x71f8,0x6018,
	0x0010,0x0000, /* g */
	0x0000,0x3fff,0x3fff,0x3fff,0x0030,0x0018,0x0018,0x3ff8,0x3ff0,0x3fe0,
	0x0000,0x0000, /* h */
	0x0000,0x0000,0x3018,0x3018,0x3ff9,0x3ff9,0x3ff9,0x3000,0x3000,0x0000,
	0x0000,0x0000, /* i */
/*Font too tall*/
	0x0000,0x0000,0x4018,0x0018,0x0018,0x0018,0x7ff9,0x7ff9,0x0000,0x0000,
	0x0000,0x0000, /* j */
	0x0000,0x3fff,0x3fff,0x3fff,0x01c0,0x03e0,0x0f70,0x1e38,0x3c18,0x3008,
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	0x0000,0x0000, /* o */
/*Font too tall*/
	0x0000,0x7ff8,0x7ff8,0x7ff8,0x1838,0x3018,0x3018,0x3838,0x1ff0,0x0fe0,
	0x0000,0x0000, /* p */
/*Font too tall*/
	0x0000,0x0fe0,0x1ff0,0x3c38,0x3018,0x3018,0x3838,0x7ff8,0x7ff8,0x7ff8,
	0x0000,0x0000, /* q */
	0x0000,0x0000,0x3ff8,0x3ff8,0x00e0,0x0030,0x0018,0x0018,0x0038,0x0078,
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	0x2000,0x0000, /* x */
/*Font too tall*/
	0x0000,0x0018,0x00f8,0x07f0,0x7f80,0x7c00,0x7f00,0x0fe0,0x01f8,0x0038,
	0x0000,0x0000, /* y */
	0x0000,0x3018,0x3c18,0x3e18,0x3f18,0x33d8,0x31f8,0x3078,0x3038,0x3018,
	0x0000,0x0000, /* z */
/*Font too tall*/
	0x0000,0x0300,0x0300,0x7ffc,0x7cfe,0x0007,0x0003,0x0003,0x0003,0x0000,
	0x0000,0x0000, /* { */
/*Font too tall*/
	0x0000,0x0000,0x0000,0x0000,0x7fff,0x7fff,0x7fff,0x0000,0x0000,0x0000,
	0x0000,0x0000, /* | */
/*Font too tall*/
	0x0000,0x0003,0x0003,0x0003,0x0007,0x7cfe,0x7ffe,0x0300,0x0300,0x0000,
	0x0000,0x0000, /* } */
	0x0000,0x0020,0x0070,0x0030,0x0030,0x0030,0x0060,0x0060,0x0060,0x0030,
	0x0000,0x0000, /* ~ */
	0x0000,0x0000,0x0000,0x0000,0x0000,0x0000,0x0000,0x0000,0x0000,0x0000,
	0x0000,0x0000, /*   */
};
static const Font gBigFont = {
	BIG_FONT_LINE_COUNT,
	BIG_FONT_CHARS_PER_LINE,
	BIG_FONT_HEIGHT,
	BIG_FONT_WIDTH,
	BIG_FONT_CHAR_START,
	BIG_FONT_CHAR_END,
	0, /* CenteredByDefault */
	0,
	gBigFontGlyphs
};
