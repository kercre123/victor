#define LARGE_FONT_WIDTH 18
#define LARGE_FONT_HEIGHT 32

#define LARGE_FONT_LINE_COUNT     (DISPLAY_SCREEN_HEIGHT/LARGE_FONT_HEIGHT)
#define LARGE_FONT_CHARS_PER_LINE (DISPLAY_SCREEN_WIDTH/LARGE_FONT_WIDTH)

#define LARGE_FONT_CHAR_START 32
#define LARGE_FONT_CHAR_END 126


static const uint32_t gLargeFontGlyphs[] = {
	0x00000000,0x00000000,0x00000000,0x00000000,0x00000000,0x00000000,0x00000000,0x00000000,0x00000000,0x00000000,
	0x00000000,0x00000000,0x00000000,0x00000000,0x00000000,0x00000000,0x00000000,0x00000000, /*   */
	0x00000000,0x00000000,0x00000000,0x00000000,0x00000000,0x00000000,0x00000000,0x003c7fff,0x003c7fff,0x003c7fff,
	0x003c7fff,0x00000000,0x00000000,0x00000000,0x00000000,0x00000000,0x00000000,0x00000000, /* ! */
	0x00000000,0x00000000,0x00000000,0x000000ff,0x000000ff,0x000000ff,0x000000ff,0x00000000,0x00000000,0x00000000,
	0x00000000,0x000000ff,0x000000ff,0x000000ff,0x000000ff,0x00000000,0x00000000,0x00000000, /* " */
/*Image must be wider than 18*/
	0x0000e000,0x0000e000,0x003ce1c0,0x003fe1c0,0x003ff9c0,0x000fffc0,0x0000fff8,0x0000e7ff,0x0038e1ff,0x003fe1cf,
	0x003ff9c0,0x001fffc0,0x0000fff8,0x0000efff,0x0000e1ff,0x0000e1df,0x000001c0,0x000001c0, /* # */
	0x00000000,0x00000000,0x001e07c0,0x001c0fe0,0x003c1ff0,0x00383ff8,0x00383c78,0x00383c38,0x03ffffff,0x03ffffff,
	0x00387838,0x003c7838,0x003ff078,0x001ff070,0x000fe0f0,0x0007c000,0x00000000,0x00000000, /* $ */
	0x0000007c,0x000040fe,0x000021ff,0x000021c7,0x00001183,0x000011c7,0x000019fe,0x000008fe,0x000f8c7c,0x001fc400,
	0x003fe600,0x0038e200,0x00306300,0x0038e100,0x003fc180,0x001fc080,0x000f8000,0x00000000, /* % */
/*Image must be wider than 18*/
	0x00000000,0x0003e000,0x000ff800,0x001ffc00,0x001ffe7c,0x003e1ffe,0x003c0ffe,0x00380fff,0x00383fc7,0x00387f07,
	0x0039fe07,0x003ff807,0x001fe007,0x001fc00e,0x003f8000,0x003ff800,0x003bf800,0x0020f800, /* & */
	0x00000000,0x00000000,0x00000000,0x00000000,0x00000000,0x00000000,0x00000000,0x000000ff,0x000000ff,0x000000ff,
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	0x000fffe0,0x0001ff00,0x00000000,0x00000000,0x00000000,0x00000000,0x00000000,0x00000000, /* ) */
/*Image must be wider than 18*/
	0x00000000,0x00010100,0x00038380,0x0001c700,0x0001c700,0x0000ee00,0x00006c00,0x00007c00,0x001ffff0,0x001ffff0,
	0x001ffff0,0x00007c00,0x00006c00,0x0000ee00,0x0001c700,0x0001c700,0x00038380,0x00010300, /* * */
	0x00000000,0x00000000,0x00003800,0x00003800,0x00003800,0x00003800,0x00003800,0x00003800,0x001fffe0,0x001fffe0,
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	0x003e0007,0x001fffff,0x001fffff,0x000fffff,0x0003ffff,0x00000000,0x00000000,0x00000000, /* J */
/*Image must be wider than 18*/
	0x00000000,0x00000000,0x003fffff,0x003fffff,0x003fffff,0x003fffff,0x00003f00,0x00001f80,0x00001fe0,0x00007ff0,
	0x0001fff8,0x0007fcfc,0x001ff03f,0x003fc01f,0x003f000f,0x003c0007,0x00380001,0x00200000, /* K */
	0x00000000,0x00000000,0x00000000,0x003fffff,0x003fffff,0x003fffff,0x003fffff,0x00380000,0x00380000,0x00380000,
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	0x00fc000f,0x01ff003e,0x03fffffe,0x01dffffc,0x0087fff0,0x0000ffc0,0x00000000,0x00000000, /* Q */
/*Image must be wider than 18*/
	0x00000000,0x00000000,0x003fffff,0x003fffff,0x003fffff,0x003fffff,0x00001c07,0x00001c07,0x00001c07,0x00003c07,
	0x00007c07,0x0003fe0f,0x000ffffe,0x003fe7fe,0x003fc7fc,0x003e01f8,0x00380000,0x00200000, /* R */
	0x00000000,0x00000000,0x000f00f8,0x001e03fc,0x001e03fe,0x003c07fe,0x003807cf,0x00380f87,0x00380f07,0x00380f07,
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	0x003ff800,0x003fffc0,0x000ffffe,0x00007fff,0x000007ff,0x0000007f,0x00000003,0x00000000, /* V */
/*Image must be wider than 18*/
	0x0000000f,0x00000fff,0x000fffff,0x003fffff,0x003fff80,0x003f8000,0x003ffc00,0x0003ffc0,0x00001fc0,0x00001fc0,
	0x0003ffc0,0x003ffe00,0x003fc000,0x003ffe00,0x003fffff,0x003fffff,0x00001fff,0x0000000f, /* W */
	0x00200001,0x00380007,0x003c000f,0x003f003f,0x003fc0ff,0x000ff3fc,0x0003fff0,0x0001ffe0,0x00007f80,0x0000ffe0,
	0x0003fff0,0x000ff3fc,0x003fc0ff,0x003f003f,0x003c000f,0x00380007,0x00200001,0x00000000, /* X */
/*Image must be wider than 18*/
	0x00000001,0x00000007,0x0000001f,0x0000007f,0x000001ff,0x000003fc,0x00000ff0,0x003fffc0,0x003fff00,0x003fff00,
	0x003fffc0,0x00000ff0,0x000003fc,0x000001ff,0x0000007f,0x0000001f,0x00000007,0x00000001, /* Y */
	0x00000000,0x00000000,0x003e0007,0x003f0007,0x003f8007,0x003fe007,0x003ff007,0x0039fc07,0x0038fe07,0x00383f87,
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	0x0000001f,0x0000003e,0x0000007c,0x000000f0,0x000000e0,0x000000c0,0x00000080,0x00000000, /* ^ */
/*Image must be wider than 18*/
	0x0e000000,0x0e000000,0x0e000000,0x0e000000,0x0e000000,0x0e000000,0x0e000000,0x0e000000,0x0e000000,0x0e000000,
	0x0e000000,0x0e000000,0x0e000000,0x0e000000,0x0e000000,0x0e000000,0x0e000000,0x0e000000, /* _ */
	0x00000000,0x00000000,0x00000000,0x00000000,0x00000000,0x00000001,0x00000003,0x00000007,0x0000000f,0x0000000c,
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	0x003fe000,0x003ffc00,0x000fffc0,0x0001ffc0,0x00003fc0,0x000007c0,0x000000c0,0x00000000, /* v */
/*Image must be wider than 18*/
	0x000001c0,0x00003fc0,0x0007ffc0,0x003fffc0,0x003ff000,0x003c0000,0x003fe000,0x000ffc00,0x0000fc00,0x0000fc00,
	0x000ffc00,0x003fc000,0x003c0000,0x003ff000,0x003fffc0,0x000fffc0,0x00003fc0,0x000001c0, /* w */
	0x00000000,0x00200040,0x003000c0,0x003c01c0,0x003e07c0,0x003f8fc0,0x001fdf80,0x0007ff00,0x0001fc00,0x0001fc00,
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	0x00000000,0x00000000,0x00000000,0x00000000,0x00000000,0x00000000,0x00000000,0x00000000, /*   */
};
static const Font gLargeFont = {
	LARGE_FONT_LINE_COUNT,
	LARGE_FONT_CHARS_PER_LINE,
	LARGE_FONT_HEIGHT,
	LARGE_FONT_WIDTH,
	LARGE_FONT_CHAR_START,
	LARGE_FONT_CHAR_END,
	1, /* CenteredByDefault */
	0,
	gLargeFontGlyphs
};
