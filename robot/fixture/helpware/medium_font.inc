#define MEDIUM_FONT_WIDTH 9
#define MEDIUM_FONT_HEIGHT 12
#define MEDIUM_FONT_SPAN 9

#define MEDIUM_FONT_LINE_COUNT     (DISPLAY_SCREEN_HEIGHT/MEDIUM_FONT_HEIGHT)
#define MEDIUM_FONT_CHARS_PER_LINE (DISPLAY_SCREEN_WIDTH/MEDIUM_FONT_SPAN)

#define MEDIUM_FONT_CHAR_START 32
#define MEDIUM_FONT_CHAR_END 126
#define MEDIUM_FONT_UNPRINTABLE 95


static const uint16_t gMediumFontGlyphs[] = {
	0x0000,0x0000,0x0000,0x0000,0x0000,0x0000,0x0000,0x0000,0x0000, /*   */
	0x0000,0x0000,0x0000,0x037f,0x037f,0x0000,0x0000,0x0000,0x0000, /* ! */
	0x0000,0x0000,0x0007,0x0007,0x0000,0x0007,0x0000,0x0000,0x0000, /* " */
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	0x0000,0x0018,0x0018,0x0018,0x00fe,0x0018,0x0018,0x0018,0x0000, /* + */
/*Font too tall*/
	0x0000,0x0000,0x0000,0x0300,0x0700,0x0200,0x0000,0x0000,0x0000, /* , */
	0x0000,0x0018,0x0018,0x0018,0x0018,0x0018,0x0018,0x0000,0x0000, /* - */
	0x0000,0x0000,0x0000,0x0180,0x0180,0x0000,0x0000,0x0000,0x0000, /* . */
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	0x0100,0x0380,0x0303,0x0303,0x03ff,0x01ff,0x0003,0x0003,0x0000, /* J */
/*Image must be wider than 9*/
	0x0000,0x01ff,0x01ff,0x001c,0x003e,0x00e3,0x01c1,0x0180,0x0100, /* K */
	0x0000,0x03ff,0x03ff,0x0300,0x0300,0x0300,0x0300,0x0300,0x0000, /* L */
	0x0000,0x03ff,0x000f,0x0038,0x0070,0x001e,0x03ff,0x03ff,0x0000, /* M */
	0x0000,0x03ff,0x0007,0x001e,0x0078,0x01c0,0x03ff,0x03ff,0x0000, /* N */
	0x0078,0x01fe,0x0387,0x0303,0x0303,0x0303,0x01fe,0x00fc,0x0000, /* O */
	0x0000,0x03ff,0x03ff,0x0033,0x0033,0x0013,0x001f,0x000e,0x0000, /* P */
/*Font too tall*/
	0x0078,0x03fe,0x0387,0x0603,0x0603,0x0603,0x03fe,0x01fc,0x0000, /* Q */
	0x0000,0x03ff,0x03ff,0x0033,0x0073,0x01f3,0x039f,0x030e,0x0000, /* R */
	0x0100,0x018e,0x031f,0x0313,0x0333,0x0323,0x01e6,0x00c2,0x0000, /* S */
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	0x0000,0x000c,0x03fe,0x03ff,0x000d,0x000d,0x000d,0x0001,0x0000, /* f */
/*Font too tall*/
	0x0000,0x05b8,0x03fc,0x03cc,0x034c,0x027c,0x063c,0x040c,0x0000, /* g */
	0x0000,0x03ff,0x03ff,0x000c,0x000c,0x000c,0x03fc,0x03f0,0x0000, /* h */
	0x0000,0x0000,0x0186,0x01fe,0x01fe,0x0180,0x0180,0x0000,0x0000, /* i */
	0x0400,0x0600,0x0406,0x0406,0x07fe,0x07fe,0x0000,0x0000,0x0000, /* j */
/*Image must be wider than 9*/
	0x0000,0x03ff,0x03ff,0x0030,0x00f8,0x01dc,0x038c,0x0204,0x0200, /* k */
	0x0000,0x0301,0x0301,0x03ff,0x03ff,0x0300,0x0300,0x0000,0x0000, /* l */
	0x0000,0x03fc,0x000c,0x03fc,0x03fc,0x000c,0x03fc,0x03fc,0x0000, /* m */
	0x0000,0x03fc,0x03fc,0x000c,0x000c,0x000c,0x03fc,0x03f0,0x0000, /* n */
	0x0020,0x01f8,0x039c,0x030c,0x030c,0x030c,0x01f8,0x00f0,0x0000, /* o */
/*Font too tall*/
	0x0000,0x07fc,0x07fc,0x030c,0x030c,0x030c,0x01f8,0x00f0,0x0000, /* p */
/*Font too tall*/
	0x0020,0x01f8,0x039c,0x030c,0x030c,0x0198,0x07fc,0x07fc,0x0000, /* q */
	0x0000,0x0000,0x03fc,0x0018,0x000c,0x000c,0x000c,0x001c,0x0000, /* r */
	0x0000,0x0198,0x033c,0x032c,0x036c,0x036c,0x01d8,0x0080,0x0000, /* s */
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	0x0204,0x030c,0x039c,0x01f8,0x00f0,0x01fc,0x030c,0x0204,0x0000, /* x */
/*Font too tall*/
	0x0000,0x001c,0x007c,0x07e0,0x0780,0x01f0,0x003c,0x0004,0x0000, /* y */
	0x0000,0x030c,0x038c,0x03ec,0x037c,0x033c,0x030c,0x0300,0x0000, /* z */
/*Font too tall*/
	0x0000,0x0060,0x07fc,0x07bf,0x0003,0x0003,0x0003,0x0000,0x0000, /* { */
/*Font too tall*/
	0x0000,0x0000,0x0000,0x07ff,0x07ff,0x0000,0x0000,0x0000,0x0000, /* | */
/*Font too tall*/
	0x0000,0x0003,0x0003,0x0003,0x07be,0x07fc,0x0060,0x0000,0x0000, /* } */
	0x0000,0x0018,0x0008,0x000c,0x0018,0x0018,0x0018,0x0008,0x0000, /* ~ */
	0x0000,0x0000,0x0000,0x0000,0x0000,0x0000,0x0000,0x0000,0x0000, /*  */
};

static const Font gMediumFont = {
       MEDIUM_FONT_LINE_COUNT,
       MEDIUM_FONT_CHARS_PER_LINE,
       MEDIUM_FONT_HEIGHT,
       MEDIUM_FONT_WIDTH,
       MEDIUM_FONT_CHAR_START,
       MEDIUM_FONT_CHAR_END,
       0, /* CenteredByDefault */
       MEDIUM_FONT_SPAN==MEDIUM_FONT_WIDTH,
       gMediumFontGlyphs
};
